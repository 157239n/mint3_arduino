#include <ESP_EEPROM.h>
#include <ArduinoJson.h>
#include <ESP8266WiFi.h>
#include <ESP8266HTTPClient.h>
#include <WiFiClient.h>
#include <SoftwareSerial.h>

unsigned long ac_off[] = {0,4423,8837,9450,10996,11599,12075,12679,14261,14837,16392,16995,17471,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1000000,1000000};
unsigned long ac_20[]  = {0,4396,8782,9414,10968,11572,12048,12652,14206,14810,16364,16968,17471,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1000000,1000000};
unsigned long ac_22[]  = {0,4368,8766,9398,10943,11546,12032,12626,14181,14784,16339,16942,17418,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1000000,1000000};
unsigned long ac_23[]  = {0,4396,8794,9417,10971,11575,12051,12655,14209,14813,16366,16970,17446,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1000000,1000000};
unsigned long ac_24[]  = {0,4396,8820,9396,10996,11554,12085,12634,14234,14792,16392,16950,17472,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1000000,1000000};
unsigned long ac_25[]  = {0,4396,8819,9341,10968,11499,12057,12579,14206,14737,16364,16895,17453,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1000000,1000000};
unsigned long ac_26[]  = {0,4405,8820,9376,11003,11534,12083,12605,14241,14763,16399,16921,17479,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1000000,1000000};
unsigned long ac_27[]  = {0,4396,8819,9368,10996,11499,12048,12579,14206,14710,16344,16865,17424,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1000000,1000000};

void sendSignal(unsigned long* ac_22) {
  digitalWrite(12, HIGH); delay(50);
  unsigned long startTime = micros();
  unsigned long lastTime = startTime;
  unsigned long now;
  int value = 1; int state = 0; int it = 0; // value: 0 (osc), 1 (low), it: iterator time
  while (true) {
    now = micros();
    if ((lastTime-startTime) <= ac_22[it] && ac_22[it] < (now-startTime)) { // then transitions
      value = 1-value; it++; if (ac_22[it] > 999999) return;
    }
    if (value == 0) { state = 1-state; digitalWrite(12, state); }
    else { digitalWrite(12, LOW); }
    lastTime = now; // delay: 13.16us
    asm("nop;nop;nop;nop;nop;nop;nop;nop;nop;nop;nop;nop;nop;nop;nop;nop;nop;nop;nop;nop;nop;nop;nop;nop;nop;nop;nop;nop;nop;nop;nop;nop;nop;nop;nop;nop;nop;nop;nop;nop;nop;nop;nop;nop;nop;nop;nop;nop;nop;nop;nop;nop;nop;nop;nop;nop;nop;nop;nop;nop;nop;nop;nop;nop;nop;nop;nop;nop;nop;nop;nop;nop;nop;nop;nop;nop;nop;nop;nop;nop;nop;nop;nop;nop;nop;nop;nop;nop;nop;nop;nop;nop;nop;nop;nop;nop;nop;nop;nop;nop;nop;nop;nop;nop;nop;nop;nop;nop;nop;nop;nop;nop;nop;nop;nop;nop;nop;nop;nop;nop;nop;nop;nop;nop;nop;nop;nop;nop;nop;nop;nop;nop;nop;nop;nop;nop;nop;nop;nop;nop;nop;nop;nop;nop;nop;nop;nop;nop;nop;nop;nop;nop;nop;nop;nop;nop;nop;nop;nop;nop;nop;nop;nop;nop;nop;nop;nop;nop;nop;nop;nop;nop;nop;nop;nop;nop;nop;nop;nop;nop;nop;nop;nop;nop;nop;nop;nop;nop;nop;nop;nop;nop;nop;nop;nop;nop;nop;nop;nop;nop;nop;nop;nop;nop;nop;nop;nop;nop;nop;nop;nop;nop;nop;nop;nop;nop;nop;nop;nop;nop;nop;nop;nop;nop;nop;nop;nop;nop;nop;nop;nop;nop;nop;nop;nop;nop;nop;nop;nop;nop;nop;nop;nop;nop;nop;nop;nop;nop;nop;nop;nop;nop;nop;nop;nop;nop;nop;nop;nop;nop;nop;nop;nop;nop;nop;nop;nop;nop;nop;nop;nop;nop;nop;nop;nop;nop;nop;nop;nop;nop;nop;nop;nop;nop;nop;nop;nop;nop;nop;nop;nop;nop;nop;nop;nop;nop;nop;nop;nop;nop;nop;nop;nop;nop;nop;nop;nop;nop;nop;nop;nop;nop;nop;nop;nop;nop;nop;nop;nop;nop;nop;nop;nop;nop;nop;nop;nop;nop;nop;nop;nop;nop;nop;nop;nop;nop;nop;nop;nop;nop;nop;nop;nop;nop;nop;nop;nop;nop;nop;nop;nop;nop;nop;nop;nop;nop;nop;nop;nop;nop;nop;nop;nop;nop;nop;nop;nop;nop;nop;nop;nop;nop;nop;nop;nop;nop;nop;nop;nop;nop;nop;nop;nop;nop;nop;nop;nop;nop;nop;nop;nop;nop;nop;nop;nop;nop;nop;nop;nop;nop;nop;nop;nop;nop;nop;nop;nop;nop;nop;nop;nop;nop;nop;nop;nop;nop;nop;nop;nop;nop;nop;nop;nop;nop;nop;nop;nop;nop;nop;nop;nop;nop;nop;nop;nop;nop;nop;nop;nop;nop;nop;nop;nop;nop;nop;nop;nop;nop;nop;nop;nop;nop;nop;nop;nop;nop;nop;nop;nop;nop;nop;nop;nop;nop;nop;nop;nop;nop;nop;nop;nop;nop;nop;nop;nop;nop;nop;nop;nop;nop;nop;nop;nop;nop;nop;nop;nop;nop;nop;nop;nop;nop;nop;nop;nop;nop;nop;nop;nop;nop;nop;nop;nop;nop;nop;nop;nop;nop;nop;nop;nop;nop;nop;nop;nop;nop;nop;nop;nop;nop;nop;nop;nop;nop;nop;nop;nop;nop;nop;nop;nop;nop;nop;nop;nop;nop;nop;nop;nop;nop;nop;nop;nop;nop;nop;nop;nop;nop;nop;nop;nop;nop;nop;nop;nop;nop;nop;nop;nop;nop;nop;nop;nop;nop;nop;nop;nop;nop;nop;nop;nop;nop;nop;nop;nop;nop;nop;nop;nop;nop;nop;nop;nop;nop;nop;nop;nop;nop;nop;nop;nop;nop;nop;nop;nop;nop;nop;nop;nop;nop;nop;nop;nop;nop;nop;nop;nop;nop;nop;nop;nop;nop;nop;nop;nop;nop;nop;nop;nop;nop;nop;nop;nop;nop;nop;nop;nop;nop;nop;nop;nop;nop;nop;nop;nop;nop;nop;nop;nop;nop;nop;nop;nop;nop;nop;nop;nop;nop;nop;nop;nop;nop;nop;nop;nop;nop;nop;nop;nop;nop;nop;nop;nop;nop;nop;nop;nop;nop;nop;nop;nop;nop;nop;nop;nop;nop;nop;nop;nop;nop;nop;nop;nop;nop;nop;nop;nop;nop;nop;nop;nop;nop;nop;nop;nop;nop;nop;nop;nop;nop;nop;nop;nop;nop;nop;nop;nop;nop;nop;nop;nop;nop;nop;nop;nop;nop;nop;nop;nop;nop;nop;nop;nop;nop;nop;nop;nop;nop;nop;nop;nop;nop;nop;nop;nop;nop;nop;nop;nop;nop;nop;nop;nop;nop;nop;nop;nop;nop;nop;nop;nop;nop;nop;nop;nop;nop;nop;nop;nop;nop;nop;nop;nop;nop;nop;nop;nop;nop;nop;nop;nop;nop;nop;nop;nop;nop;nop;nop;nop;nop;nop;nop;nop;nop;nop;nop;nop;nop;nop;nop;nop;nop;nop;nop;nop;nop;nop;nop;nop;nop;nop;nop;nop;nop;nop;nop;nop;nop;nop;nop;nop;nop;nop;nop;nop;nop;nop;nop;nop;nop;nop;nop;nop;nop;nop;nop;nop;nop;nop;nop;nop;nop;nop;nop;nop;nop;nop;nop;nop;nop;nop;nop;nop;nop;nop;nop;nop;nop;nop;nop;nop;nop;nop;nop;nop;nop;nop;nop;nop;nop;nop;nop;nop;nop;nop;nop;nop;nop;nop;nop;nop;nop;nop;nop;nop;nop;nop;nop;nop;nop;nop;nop;nop;nop;nop;nop;nop;nop;nop;nop;nop;nop;nop;nop;nop;nop;nop;nop;nop;nop;nop;nop;nop;nop;nop;nop;nop;nop;nop;nop;nop;nop;nop;nop;nop;nop;nop;nop;nop;nop;nop;nop;nop;nop;nop;nop;nop;nop;nop;nop;nop;nop;nop;nop;nop;nop;nop;nop;nop;nop;nop;nop;nop;nop;nop;nop;nop;nop;nop;nop;nop;nop;nop;nop;nop;nop;nop;nop;nop;nop;nop;nop;nop;nop;nop;nop;nop;nop;nop;nop;nop;nop;nop;nop;nop;nop;nop;nop;nop;nop;nop;nop;nop;nop;nop;nop;nop;nop;nop;nop;nop;nop;nop;nop;nop;nop;nop;nop;nop;nop;");
  }
  digitalWrite(12, HIGH);
}

long deviceId = 0;
JsonDocument postRequest(String url, String jsonString) { // url: expects to start with a "/"
  String res = "{}";
  if (WiFi.status() == WL_CONNECTED) {
    WiFiClient client; HTTPClient http; http.setTimeout(10000);
    http.begin(client, "http://dhcp.aigu.vn" + url);
    http.addHeader("Content-Type", "application/json");
    if (http.POST(jsonString) > 0) res = http.getString();
  } JsonDocument doc; deserializeJson(doc, res); return doc;
}
void clipLastChar(String& a) { a.remove(a.length()-1, 1); }
bool debug = true; void print(String msg) { if (debug) Serial.print(msg); } void println(String msg) { if (debug) Serial.println(msg); }

unsigned long poll_lastPoll = 0; String pollJson = ""; float poll_freq = 1;
void handlePoll() {
  unsigned long now = millis(); if (poll_lastPoll > now) { poll_lastPoll = 0; } // for overflow
  if (now - poll_lastPoll > 1000.0/poll_freq) {
    println("polling: " + String(random(3, 30))); poll_lastPoll = now; // tag along freqRead data if we're recording
    if (pollJson.length() > 0) clipLastChar(pollJson); pollJson = "{\"results\":[" + pollJson + "]}";
    // println("pollJson: " + pollJson);
    JsonDocument doc = postRequest("/poll/" + String(deviceId), pollJson); int dId = doc["deviceId"]; pollJson = "";
    if (dId <= 0) { return; } poll_freq = doc["freq"]; int nComs = doc["nComs"]; // request unsuccessful
    for (int i = 0; i < nComs; i++) {
      auto payload = doc["commands"][i];
      pollJson = pollJson + "{\"comId\":" + String(payload["comId"]) + ",\"result\":";
      if (payload["type"] == "digitalWrite") {
        Serial.println("digitalWrite:" + String(payload["pin"]));
        pollJson = pollJson + "0},";
        if (payload["pin"] == 0) { sendSignal(ac_off);
        } else if (payload["pin"] == 1) { for (int i = 0; i<4; i++) { sendSignal(ac_24); delay(100); }
        } else if (payload["pin"] == 20) { sendSignal(ac_20);
        } else if (payload["pin"] == 21) { // sendSignal(ac_22);
        } else if (payload["pin"] == 22) { sendSignal(ac_22);
        } else if (payload["pin"] == 23) { sendSignal(ac_23);
        } else if (payload["pin"] == 24) { sendSignal(ac_24);
        } else if (payload["pin"] == 25) { sendSignal(ac_25);
        } else if (payload["pin"] == 26) { sendSignal(ac_26);
        } else if (payload["pin"] == 27) { sendSignal(ac_27);
        } else { pinMode(payload["pin"], OUTPUT); digitalWrite(payload["pin"], (int) (payload["onoff"])); }
      } else if (payload["type"] == "analogWrite")  {
        pollJson = pollJson + "0},"; pinMode(payload["pin"], OUTPUT); analogWrite(payload["pin"], ((int) payload["value"])*256/100);
      } else { pollJson = pollJson + "\"notimplemented\"},"; }
    }
  }
}

void setup() {
  EEPROM.begin(16); EEPROM.get(0, deviceId); Serial.begin(9600); WiFi.begin("Quang Ho", "quangho2000");
  println("Connecting to wifi..."); while (WiFi.status() != WL_CONNECTED) { delay(100); print("."); } println("Connected to wifi");
  if (deviceId == 0) { // registers a new device
    deviceId = postRequest("/newId", "{\"project\":\"nothing\",\"model\":\"esp8266\"}")["id"];
    if (deviceId > 0) { EEPROM.put(0, deviceId); EEPROM.commit(); } // request actually successful
  }
  pinMode(LED_BUILTIN, OUTPUT); digitalWrite(LED_BUILTIN, HIGH);
  pinMode(14, OUTPUT); pinMode(14, LOW); pinMode(12, OUTPUT); digitalWrite(12, 1);
}

void loop() {
  handlePoll();
}



